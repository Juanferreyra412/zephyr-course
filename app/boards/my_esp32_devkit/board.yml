## app/boards/my_esp32_devkit/board.yml
```yaml
board:
  name: my_esp32_devkit
  full_name: My ESP32 DevKit Board
  vendor: espressif
  socs:
  - name: esp32
```

## app/drivers/my_driver/Kconfig
```kconfig
config MY_DRIVER
    bool "Enable my Driver"
    default n
    select GPIO
    # select SENSOR
    depends on DT_HAS_MY_DRIVER_ENABLED
    help
        Enable my Driver

if MY_DRIVER

config LED_DEFAULT_ON
    bool "LED default ON state"
    default n
    help
        Set the LED default ON state
endif
```
